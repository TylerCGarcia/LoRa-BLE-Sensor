## CMakeLists.txt
```
# SPDX-License-Identifier: Apache-2.0

cmake_minimum_required(VERSION 3.20.0)

find_package(Zephyr REQUIRED HINTS $ENV{ZEPHYR_BASE})

project(sensor_app_tests)

target_include_directories(app PRIVATE 
    ${CMAKE_CURRENT_SOURCE_DIR}/../../../include
)

target_sources(app PRIVATE src/main.c
    ${CMAKE_CURRENT_SOURCE_DIR}/../../../src/sensor_data.c
)
```

## prj.conf
```kconfig
CONFIG_ZTEST=y
# CONFIG_GPIO=y
# CONFIG_GPIO_EMUL=y
# CONFIG_ADC=y
# CONFIG_ADC_EMUL=y
# CONFIG_FPU=y
```

## src/main.c
```c
/*
 * Copyright (c) 2016 Intel Corporation
 *
 * SPDX-License-Identifier: Apache-2.0
 * Tests:
 */

#include <zephyr/ztest.h>

ZTEST_SUITE(app, NULL, NULL, NULL, NULL, NULL);

ZTEST(app, test_app_setup)
{
    zassert_ok(0,"TEST");
}
```
