## prj.conf
```kconfig
CONFIG_ZTEST=y
# CONFIG_COUNTER=y
# CONFIG_GPIO=y
# CONFIG_GPIO_EMUL=y
# CONFIG_ADC=y
# CONFIG_ADC_EMUL=y
# CONFIG_FPU=y
```

## src/main.c
```c
/*
 * Copyright (c) 2016 Intel Corporation
 *
 * SPDX-License-Identifier: Apache-2.0
 * Tests:
 */

#include <zephyr/ztest.h>
// #include <zephyr/drivers/counter.h>


ZTEST_SUITE(memory, NULL, NULL, NULL, NULL, NULL);

ZTEST(memory, test_memory_setup)
{
    zassert_ok(0,"TEST");
}
```
