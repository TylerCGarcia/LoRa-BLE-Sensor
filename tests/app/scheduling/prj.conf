## prj.conf
```kconfig
CONFIG_ZTEST=y
CONFIG_COUNTER=y
# using rtc as clock source
CONFIG_COUNTER_NATIVE_SIM_FREQUENCY=1
CONFIG_COUNTER_NATIVE_SIM_NBR_CHANNELS=3
# CONFIG_GPIO=y
# CONFIG_GPIO_EMUL=y
# CONFIG_ADC=y
# CONFIG_ADC_EMUL=y
# CONFIG_FPU=y
```

## src/main.c
```c
/*
 * Copyright (c) 2016 Intel Corporation
 *
 * SPDX-License-Identifier: Apache-2.0
 * Tests:
 * - Confirm schedule can be initialized
 * - multiple actions can be tied to one alarm 
 * - actions can be scheduled to occur at different times
 * - 
 */

#include <zephyr/ztest.h>

LOG_MODULE_REGISTER(tests_scheduling, LOG_LEVEL_DBG);

ZTEST_SUITE(scheduling, NULL, NULL, NULL, NULL, NULL);

ZTEST(scheduling, test_scheduling_init)
{
    zassert_true(true, "Scheduling init failed");
}
```
