## app/Kconfig
```kconfig
menu "App Version"

config APP_VERSION_MAJOR
	int "Firmware major verison number"
	default 1

config APP_VERSION_MINOR
	int "Firmware minor verison number"
	default 0

config APP_VERSION_PATCH
	int "Firmware patch verison number"
	default 0

config APP_VERSION_COMMIT
	int "Firmware commit verison number"
	default 0

config APP_VERSION_HASH
	string "Firmware version hash provided by Git"
	default ""

config APP_VERSION
	string "Full firmware version string provided by Git"
	default "1.0.0"

endmenu

menu "Zephyr Kernel"
source "Kconfig.zephyr"
endmenu
```

## app/west.yml
```yaml
manifest:
  remotes:
    - name: zephyrproject-rtos
      url-base: https://github.com/zephyrproject-rtos
  projects:
    - name: zephyr
      repo-path: zephyr
      remote: zephyrproject-rtos
      revision: v4.1.0
      import:
        path-prefix: deps
        name-allowlist:
          - hostap
          - zephyr
          - mbedtls
          - nrfxlib
          - cmsis
          - hal_nordic
          - loramac-node
```

## boards/arm/lora_ble_sensor/board.yml
```yaml
board:
  name: lora_ble_sensor
  full_name: LoRa_BLE_Sensor
  vendor: arm
  revision:
    format: major.minor.patch
    default: "1.0.0"
    revisions:
      - name: "1.0.0"
      - name: "1.1.0"
  socs:
  - name: nrf52840
```

## boards/st/lora_current_sensor/Kconfig.defconfig
```kconfig
if BOARD_LORA_CURRENT_SENSOR

config BOARD
	default "lora_current_sensor"

endif 
```

## boards/terramatrix/lora_ble_sensor/Kconfig.lora_ble_sensor
```kconfig
# LoRa-BLE-Sensor selection

# Copyright (c) 2021 Guillaume Paquet <guillaume.paquet@smile.fr>
# SPDX-License-Identifier: Apache-2.0

config BOARD_LORA_BLE_SENSOR
	select SOC_NRF52840_QIAA
```

## manifest/west.yml
```yaml
manifest:
  # remotes:
    # - name: nrfconnect
      # url-base: https://github.com/nrfconnect

  projects:
    - name: nrf
      # this is the sdk-nrf version, not the Zephyr version
      revision: v3.0.2
      url: https://github.com/nrfconnect/sdk-nrf
      import:
        path-prefix: deps
        name-allowlist:
          - zephyr
          - cmsis
          - cmsis_6
          - hal_nordic
          - loramac-node
          - mcuboot
          - mbedtls
          - zcbor
          - nrfxlib
          - nrf_hw_models
          - trusted-firmware-m
          - segger
          - oberon-psa-crypto
```

## tests/functionality/app/testcase.yaml
```yaml
tests:  
  functionality.app:
    harness: ztest
    timeout: 10
    platform_allow:
      - native_sim
      - qemu_cortex_m3 
```

## tests/functionality/pmic/testcase.yaml
```yaml
tests:  
  functionality.pmic:
    harness: ztest
    platform_allow:
      - native_sim
      - qemu_cortex_m3 
```

## tests/functionality/scheduling/testcase.yaml
```yaml
tests:  
  functionality.scheduling:
    harness: ztest
    platform_allow:
      - native_sim
      - qemu_cortex_m3 
```

## tests/radio/ble/testcase.yaml
```yaml
tests:  
  sensor.ble:
    tags:
      - bluetooth
    platform_allow:
      - nrf52_bsim
```

## tests/radio/lorawan/testcase.yaml
```yaml
tests:  
  sensor.lorawan:
    tags:
      - lorawan
    harness: ztest
    platform_allow:
      - native_sim
      - qemu_cortex_m3 
```

## tests/sensor/data/testcase.yaml
```yaml
tests:  
  sensor.data:
    tags:    
      - drivers
      - gpio    
      - adc
    harness: ztest
    platform_allow:
      - native_sim
      - qemu_cortex_m3 
```

## tests/sensor/names/testcase.yaml
```yaml
tests:  
  sensor.names:
    harness: ztest
    platform_allow:
      - native_sim
      - qemu_cortex_m3 
```

## tests/sensor/power/testcase.yaml
```yaml
tests:  
  sensor.power:
    tags:    
      - drivers
      - gpio    
      - adc
      - regulator
    harness: ztest
    platform_allow:
      - native_sim
      - qemu_cortex_m3 
```

## tests/sensor/sensor_power/testcase.yaml
```yaml
tests:  
  sensor.sensor_power:
    tags:    
      - drivers
      - gpio    
      - adc
      - regulator
    harness: ztest
    depends_on: adc
    platform_allow:
      - native_sim
      - qemu_cortex_m3 
```

## tests/sensor_power_tests/testcase.yaml
```yaml
tests:
  lora_ble_sensor_tests.sensor_power_tests:
    platform_allow:
      - native_sim
      - qemu_cortex_m3 
      - lora_ble_sensor
    tags: sensor_power_tests
```

## tests/system/timer/testcase.yaml
```yaml
tests:  
  system.timer:
    harness: ztest
    platform_allow:
      - native_sim
      - qemu_cortex_m3 
```

## west.yml
```yaml
manifest:
  remotes:
    - name: zephyrproject-rtos
      url-base: https://github.com/zephyrproject-rtos
  projects:
    - name: zephyr
      repo-path: zephyr
      remote: zephyrproject-rtos
      revision: v4.1.99
      import:
        path-prefix: deps
        path: zephyr
        name-allowlist:
          - hostap
          - zephyr
          - mbedtls
          - nrfxlib
          - cmsis
          - hal_nordic
```
